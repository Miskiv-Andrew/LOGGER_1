/*
 * ============================================================================
 * rtc_service.c
 * ============================================================================
 *
 * Модуль обслуживания аппаратных часов реального времени (RTC)
 * микроконтроллера STM32L4P5RET6.
 *
 * НАЗНАЧЕНИЕ:
 *
 * 1. Установка даты и времени аппаратного RTC.
 *
 * 2. Чтение текущей даты и времени аппаратного RTC.
 *
 * 3. Преобразование даты и времени между:
 *
 *      GPS_TimeStamp
 *
 *    и аппаратными структурами STM32 HAL:
 *
 *      RTC_TimeTypeDef
 *      RTC_DateTypeDef
 *
 * ============================================================================
 *
 * ОСНОВНЫЕ ПРАВИЛА:
 *
 * - Все даты и время используются в UTC.
 *
 * - Год GPS_TimeStamp хранится полностью: 2000...2099.
 *
 * - Аппаратный RTC STM32 хранит последние две цифры года.
 *
 * - Установка RTC выполняется только по команде вызывающего модуля.
 *
 * - Чтение RTC не изменяет его показания.
 *
 * - Управление состояниями LOGGER здесь не выполняется.
 *
 * ============================================================================
 */

#include "rtc_service.h"


/*
 * ============================================================================
 * Внешний аппаратный объект RTC.
 * ============================================================================
 *
 * Объект hrtc создаётся и инициализируется кодом STM32CubeMX.
 *
 * Модуль rtc_service.c использует уже существующий объект.
 *
 * Повторно создавать или инициализировать RTC здесь не требуется.
 */
extern RTC_HandleTypeDef hrtc;


/*
 * ============================================================================
 * RTC_Service_IsLeapYear()
 * ============================================================================
 *
 * Вспомогательная функция.
 *
 * Определяет, является ли указанный год високосным.
 *
 * Правила григорианского календаря:
 *
 * - год, кратный 400, високосный;
 * - год, кратный 100, не високосный;
 * - остальные годы, кратные 4, високосные.
 *
 * Возвращает:
 *
 * 1 - год високосный;
 * 0 - год обычный.
 * ============================================================================
 */
static uint8_t RTC_Service_IsLeapYear(uint16_t year)
{
    if ((year % 400U) == 0U)
    {
        return 1U;
    }

    if ((year % 100U) == 0U)
    {
        return 0U;
    }

    if ((year % 4U) == 0U)
    {
        return 1U;
    }

    return 0U;
}


/*
 * ============================================================================
 * RTC_Service_IsValidTimestamp()
 * ============================================================================
 *
 * Вспомогательная функция.
 *
 * Проверяет календарную корректность структуры GPS_TimeStamp.
 *
 * Проверяются:
 *
 * - допустимый диапазон года;
 * - номер месяца;
 * - количество дней в месяце;
 * - високосный февраль;
 * - часы;
 * - минуты;
 * - секунды.
 *
 * Возвращает:
 *
 * 1 - дата и время корректны;
 * 0 - обнаружены некорректные значения.
 *
 * Функция не изменяет переданную структуру.
 * ============================================================================
 */
static uint8_t RTC_Service_IsValidTimestamp(
    const GPS_TimeStamp *timestamp)
{
    uint8_t max_day;

    /*
     * Проверяем указатель.
     */
    if (timestamp == NULL)
    {
        return 0U;
    }

    /*
     * Аппаратный RTC STM32 хранит двузначный год.
     *
     * В LOGGER используем диапазон 2000...2099.
     */
    if ((timestamp->year < 2000U) ||
        (timestamp->year > 2099U))
    {
        return 0U;
    }

    /*
     * Проверяем месяц.
     */
    if ((timestamp->month < 1U) ||
        (timestamp->month > 12U))
    {
        return 0U;
    }

    /*
     * Проверяем время.
     */
    if ((timestamp->hour > 23U) ||
        (timestamp->minute > 59U) ||
        (timestamp->second > 59U))
    {
        return 0U;
    }

    /*
     * По умолчанию месяц содержит 31 день.
     */
    max_day = 31U;

    /*
     * Апрель, июнь, сентябрь и ноябрь
     * содержат по 30 дней.
     */
    if ((timestamp->month == 4U) ||
        (timestamp->month == 6U) ||
        (timestamp->month == 9U) ||
        (timestamp->month == 11U))
    {
        max_day = 30U;
    }

    /*
     * Для февраля учитываем високосный год.
     */
    else if (timestamp->month == 2U)
    {
        if (RTC_Service_IsLeapYear(timestamp->year) != 0U)
        {
            max_day = 29U;
        }
        else
        {
            max_day = 28U;
        }
    }

    /*
     * Проверяем день месяца.
     */
    if ((timestamp->day < 1U) ||
        (timestamp->day > max_day))
    {
        return 0U;
    }

    return 1U;
}


/*
 * ============================================================================
 * RTC_Service_CalculateWeekDay()
 * ============================================================================
 *
 * Вспомогательная функция.
 *
 * Вычисляет день недели по григорианской календарной дате.
 *
 * Используется формула Целлера.
 *
 * Формат результата STM32 HAL:
 *
 * 1 - понедельник;
 * 2 - вторник;
 * 3 - среда;
 * 4 - четверг;
 * 5 - пятница;
 * 6 - суббота;
 * 7 - воскресенье.
 *
 * Параметр timestamp должен содержать корректную дату.
 *
 * Проверка даты выполняется вызывающей функцией.
 * ============================================================================
 */
static uint8_t RTC_Service_CalculateWeekDay(
    const GPS_TimeStamp *timestamp)
{
    uint32_t year;
    uint32_t month;
    uint32_t day;

    uint32_t century;
    uint32_t year_of_century;
    uint32_t zeller_day;

    /*
     * Получаем компоненты даты.
     */
    year  = timestamp->year;
    month = timestamp->month;
    day   = timestamp->day;

    /*
     * В формуле Целлера январь и февраль
     * считаются месяцами предыдущего года.
     *
     * Март = 3, ..., декабрь = 12,
     * январь = 13, февраль = 14.
     */
    if (month < 3U)
    {
        month += 12U;
        year--;
    }

    /*
     * Разделяем год на столетие и год внутри столетия.
     */
    century = year / 100U;
    year_of_century = year % 100U;

    /*
     * Формула Целлера для григорианского календаря.
     *
     * Результат:
     *
     * 0 - суббота;
     * 1 - воскресенье;
     * 2 - понедельник;
     * ...
     * 6 - пятница.
     */
    zeller_day =
        (day +
         (13U * (month + 1U)) / 5U +
         year_of_century +
         year_of_century / 4U +
         century / 4U +
         5U * century) % 7U;

    /*
     * Преобразуем результат в формат STM32 HAL:
     *
     * понедельник = 1, ..., воскресенье = 7.
     */
    return (uint8_t)(((zeller_day + 5U) % 7U) + 1U);
}


/*
 * ============================================================================
 * RTC_Service_SetTime()
 * ============================================================================
 *
 * Устанавливает дату и время аппаратного RTC STM32.
 *
 * ПАРАМЕТР:
 *
 * timestamp:
 *     Указатель на GPS_TimeStamp с датой и временем UTC.
 *
 * ВОЗВРАЩАЕТ:
 *
 * HAL_OK    - установка выполнена успешно;
 * HAL_ERROR - некорректные данные или ошибка HAL.
 *
 * ВАЖНО:
 *
 * Функция не принимает решений о необходимости синхронизации.
 *
 * Когда устанавливать RTC, определяет стейт-машина LOGGER.
 * ============================================================================
 */
HAL_StatusTypeDef RTC_Service_SetTime(
    const GPS_TimeStamp *timestamp)
{
    RTC_TimeTypeDef rtc_time = {0};
    RTC_DateTypeDef rtc_date = {0};

    /*
     * Проверяем входную дату и время.
     *
     * Некорректные данные не должны попадать
     * в аппаратные регистры RTC.
     */
    if (RTC_Service_IsValidTimestamp(timestamp) == 0U)
    {
        return HAL_ERROR;
    }

    /*
     * ------------------------------------------------------------
     * Подготавливаем время RTC.
     * ------------------------------------------------------------
     */
    rtc_time.Hours = timestamp->hour;
    rtc_time.Minutes = timestamp->minute;
    rtc_time.Seconds = timestamp->second;

    /*
     * Не применяем переходы на летнее/зимнее время.
     *
     * RTC LOGGER работает исключительно в UTC.
     */
    rtc_time.DayLightSaving = RTC_DAYLIGHTSAVING_NONE;

    rtc_time.StoreOperation = RTC_STOREOPERATION_RESET;

    /*
     * ------------------------------------------------------------
     * Подготавливаем календарную дату RTC.
     * ------------------------------------------------------------
     *
     * STM32 RTC хранит год в формате 00...99.
     *
     * Например:
     *
     * GPS_TimeStamp.year = 2026
     * RTC_DateTypeDef.Year = 26
     */
    rtc_date.Year = (uint8_t)(timestamp->year - 2000U);

    rtc_date.Month = timestamp->month;
    rtc_date.Date = timestamp->day;

    /*
     * Вычисляем день недели.
     */
    rtc_date.WeekDay =
        RTC_Service_CalculateWeekDay(timestamp);

    /*
     * ------------------------------------------------------------
     * Устанавливаем время.
     * ------------------------------------------------------------
     *
     * RTC_FORMAT_BIN означает, что передаваемые значения
     * представлены обычными двоичными числами,
     * а не в формате BCD.
     */
    if (HAL_RTC_SetTime(&hrtc,
                        &rtc_time,
                        RTC_FORMAT_BIN) != HAL_OK)
    {
        return HAL_ERROR;
    }

    /*
     * ------------------------------------------------------------
     * Устанавливаем дату.
     * ------------------------------------------------------------
     */
    if (HAL_RTC_SetDate(&hrtc,
                        &rtc_date,
                        RTC_FORMAT_BIN) != HAL_OK)
    {
        return HAL_ERROR;
    }

    /*
     * Обе операции HAL выполнены успешно.
     */
    return HAL_OK;
}


/*
 * ============================================================================
 * RTC_Service_GetTime()
 * ============================================================================
 *
 * Считывает текущую дату и время аппаратного RTC STM32.
 *
 * ПАРАМЕТР:
 *
 * timestamp:
 *     Указатель на GPS_TimeStamp для записи результата.
 *
 * ВОЗВРАЩАЕТ:
 *
 * HAL_OK    - чтение выполнено успешно;
 * HAL_ERROR - ошибка чтения или некорректные данные.
 *
 * ВАЖНО:
 *
 * STM32 HAL требует последовательного чтения:
 *
 * 1. HAL_RTC_GetTime()
 * 2. HAL_RTC_GetDate()
 *
 * Чтение даты необходимо для разблокировки
 * теневых регистров RTC.
 *
 * Функция не изменяет показания аппаратного RTC.
 * ============================================================================
 */
HAL_StatusTypeDef RTC_Service_GetTime(
    GPS_TimeStamp *timestamp)
{
    RTC_TimeTypeDef rtc_time = {0};
    RTC_DateTypeDef rtc_date = {0};

    GPS_TimeStamp result = {0};

    /*
     * Проверяем указатель выходной структуры.
     */
    if (timestamp == NULL)
    {
        return HAL_ERROR;
    }

    /*
     * ------------------------------------------------------------
     * Считываем время RTC.
     * ------------------------------------------------------------
     */
    if (HAL_RTC_GetTime(&hrtc,
                        &rtc_time,
                        RTC_FORMAT_BIN) != HAL_OK)
    {
        return HAL_ERROR;
    }

    /*
     * ------------------------------------------------------------
     * Считываем дату RTC.
     * ------------------------------------------------------------
     *
     * После успешного чтения времени необходимо
     * обязательно прочитать дату.
     */
    if (HAL_RTC_GetDate(&hrtc,
                        &rtc_date,
                        RTC_FORMAT_BIN) != HAL_OK)
    {
        return HAL_ERROR;
    }

    /*
     * ------------------------------------------------------------
     * Преобразуем аппаратные данные в GPS_TimeStamp.
     * ------------------------------------------------------------
     */
    result.year = (uint16_t)(2000U + rtc_date.Year);

    result.month = rtc_date.Month;
    result.day = rtc_date.Date;

    result.hour = rtc_time.Hours;
    result.minute = rtc_time.Minutes;
    result.second = rtc_time.Seconds;

    /*
     * Проверяем корректность считанных значений.
     *
     * Если RTC содержит некорректную дату или время,
     * вызывающий модуль должен получить HAL_ERROR.
     */
    if (RTC_Service_IsValidTimestamp(&result) == 0U)
    {
        return HAL_ERROR;
    }

    /*
     * Записываем результат только после успешного
     * чтения и проверки всех компонентов.
     *
     * При ошибке исходная структура вызывающего
     * модуля остаётся без изменений.
     */
    *timestamp = result;

    return HAL_OK;
}